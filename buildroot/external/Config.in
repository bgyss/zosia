## buildroot/external/Config.in
```kconfig
menu "zosia packages"

source "$BR2_EXTERNAL_zosia_PATH/package/llama-cpp/Config.in"

endmenu
```

## buildroot/external/configs/zosia_aarch64_defconfig
```kconfig
BR2_aarch64=y
BR2_TOOLCHAIN_BUILDROOT=y
BR2_TOOLCHAIN_BUILDROOT_MUSL=y
BR2_TOOLCHAIN_BUILDROOT_CXX=y
BR2_STATIC_LIBS=y

# When using custom kernel headers (including "same as kernel being built"),
# we must also declare which headers *series* we're on so Buildroot can set
# BR2_TOOLCHAIN_HEADERS_AT_LEAST correctly.
BR2_PACKAGE_HOST_LINUX_HEADERS_CUSTOM_6_6=y

BR2_ROOTFS_DEVICE_CREATION_DYNAMIC_DEVTMPFS=y
BR2_ROOTFS_OVERLAY="$(BR2_EXTERNAL_zosia_PATH)/../../initramfs"

BR2_LINUX_KERNEL=y
BR2_LINUX_KERNEL_IMAGE=y
BR2_LINUX_KERNEL_CUSTOM_VERSION=y
BR2_LINUX_KERNEL_CUSTOM_VERSION_VALUE="6.6.67"
BR2_LINUX_KERNEL_USE_ARCH_DEFAULT_CONFIG=y
BR2_LINUX_KERNEL_CONFIG_FRAGMENT_FILES="$(BR2_EXTERNAL_zosia_PATH)/board/zosia/linux.fragment"

BR2_TARGET_ROOTFS_CPIO=y
BR2_TARGET_ROOTFS_CPIO_GZIP=y

# llama.cpp CLI (runs from /init if present)
BR2_PACKAGE_LLAMA_CPP=y
```

## buildroot/external/package/llama-cpp/Config.in
```kconfig
config BR2_PACKAGE_LLAMA_CPP
	bool "llama.cpp (llama-run)"
	depends on BR2_TOOLCHAIN_HAS_THREADS
	help
	  Build and install llama.cpp's llama-run into /usr/bin.
```
